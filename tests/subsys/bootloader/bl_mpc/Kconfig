## tests/subsys/bootloader/bl_mpc/Kconfig
```kconfig
#
# Copyright (c) 2026 Nordic Semiconductor ASA
#
# SPDX-License-Identifier: LicenseRef-Nordic-5-Clause
#

mainmenu "BL MPC tests"

source "Kconfig.zephyr"

config TEST_BL_MPC_FAKE
	bool "Use fake MPC backend"

config TEST_BL_MPC_LOCKED_CONFLICT
	bool "Test a pre-locked conflicting override"
	depends on !TEST_BL_MPC_FAKE
```

## tests/subsys/bootloader/bl_mpc/testcase.yaml
```yaml
tests:
  bootloader.bl_mpc.unit:
    platform_allow:
      - native_sim/native/64
    integration_platforms:
      - native_sim/native/64
    extra_configs:
      - CONFIG_TEST_BL_MPC_FAKE=y
    tags:
      - bl_mpc
      - unittest
      - ci_tests_subsys_bootloader

  bootloader.bl_mpc.hardware:
    platform_allow:
      - nrf54lm20dk/nrf54lm20b/cpuapp
    integration_platforms:
      - nrf54lm20dk/nrf54lm20b/cpuapp
    tags:
      - bl_mpc
      - ci_tests_subsys_bootloader

  bootloader.bl_mpc.hardware_locked_conflict:
    platform_allow:
      - nrf54lm20dk/nrf54lm20b/cpuapp
    integration_platforms:
      - nrf54lm20dk/nrf54lm20b/cpuapp
    extra_configs:
      - CONFIG_TEST_BL_MPC_LOCKED_CONFLICT=y
    tags:
      - bl_mpc
      - ci_tests_subsys_bootloader
```
